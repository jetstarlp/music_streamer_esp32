/*
 * audio_out - I2S sink for the PCM5102A (see include/audio_out.h).
 *
 * Design notes
 * ------------
 * - Driver: i2s_std (the "new" I2S driver). The ESP32-S3 has no APLL, so the
 *   legacy-driver/APLL sink shipped with bell cannot be used.
 * - The PCM5102A runs without MCLK (SCK tied to GND): it regenerates its
 *   system clock from BCK, which therefore has to be continuous. We never stop
 *   the I2S channel while "running"; silence is sent as zeros.
 * - The DMA buffers are refilled directly in the I2S "buffer sent" interrupt
 *   (on_sent), not by a task. Bench tests showed a high-priority feeder task on
 *   core 1 being held up for ~100 ms now and then (track changes in
 *   particular), longer than the DMA can bridge: audible gaps although the
 *   ring buffer was full. The interrupt only copies 2 kB per 11.6 ms from the
 *   ring buffer, so it is cheap, and it does not depend on any task.
 * - Missed interrupts are caught up: the DMA descriptors form a ring; we keep
 *   track of the next descriptor to refill and, when one interrupt reports
 *   several finished buffers at once, refill all of them in order. Only an
 *   interrupt more than ~7 buffers (81 ms) late still causes a gap.
 * - Ring buffer: pcm_ring, lock-free single producer (audio_out_write) /
 *   single consumer (the interrupt), storage in PSRAM. Flush, tone hand-over
 *   and stop exclude the interrupt with one spinlock (eng_mux).
 * - What goes into each buffer (music, tone, fades, silence) is decided by
 *   pcm_engine, plain C that is unit-tested on the host.
 * - Seek/skip: the ~70 ms already queued in the DMA ring are rewritten with a
 *   short ramp to silence, so the new position starts quickly and click-free.
 * - Test tone: generated by a low-priority helper task (floating point is not
 *   allowed in interrupts) into its own small ring; the music ring is left
 *   alone meanwhile (the producer sees back-pressure as if paused).
 */
#include "audio_out.h"

#include <stddef.h>
#include <math.h>
#include <string.h>

#include "board_pins.h"
#include "driver/gpio.h"
#include "driver/i2s_std.h"
#include "esp_attr.h"
#include "esp_check.h"
#include "esp_heap_caps.h"
#include "esp_log.h"
#include "esp_memory_utils.h"
#include "esp_rom_lldesc.h"
#include "esp_timer.h"
#include "freertos/semphr.h"
#include "freertos/task.h"
#include "fade.h"
#include "pcm_engine.h"
#include "pcm_ring.h"
#include "tone_gen.h"

static const char *TAG = "audio_out";

/* I2S DMA: 8 x 512 frames = ~93 ms ring @ 44.1 kHz (16 kB internal RAM). */
#define I2S_DMA_DESC_NUM        8
#define I2S_DMA_FRAME_NUM       512

/* Helper task: test tone generation and logging; nothing time-critical. */
#define AUX_TASK_PRIO           5
#define AUX_TASK_STACK          3072

/* Tone ring: 32 kB = ~186 ms, filled in 1024-frame steps. */
#define TONE_RING_BYTES         (32 * 1024)
#define TONE_CHUNK_FRAMES       1024

/* PCM5102A: XSMT soft-(un)mute ramps; give the PLL time to lock on BCK first. */
#define UNMUTE_DELAY_MS         10
#define MUTE_RAMP_MS            5

/* After an underrun with a prebuffer configured, do not wait longer than this
 * for the prebuffer to fill (covers the last second of a track or a pause). */
#define PREBUFFER_MAX_WAIT_MS   2000

typedef struct {
    bool                 initialised;
    audio_out_config_t   cfg;

    i2s_chan_handle_t    tx;
    pcm_ring_t           ring;              /* music, PSRAM */
    uint8_t             *ring_storage;
    pcm_ring_t           tone_ring;         /* test tone, PSRAM */
    uint8_t             *tone_storage;
    int16_t             *tone_scratch;
    SemaphoreHandle_t    space_sem;         /* given by the interrupt when it freed space */
    SemaphoreHandle_t    state_lock;        /* serialises start/stop/set_mute */
    SemaphoreHandle_t    send_lock;         /* producer's write vs. flush */
    TaskHandle_t         aux;

    volatile bool        running;
    volatile bool        muted;
    volatile uint16_t    volume;            /* last audio_out_set_volume() */
    volatile uint32_t    flush_gen;         /* incremented by every audio_out_flush() */

    /* --- shared with the interrupt, under eng_mux --- */
    portMUX_TYPE         eng_mux;
    pcm_engine_t         eng;
    lldesc_t            *next_fill;         /* next DMA descriptor to refill, NULL = unknown */
    bool                 rewrite_req;       /* flush: rewrite the queued DMA buffers */

    /* --- interrupt bookkeeping (written by the interrupt only) --- */
    int64_t              last_isr_us;       /* 0 = no interrupt since start */
    uint32_t             period_us;         /* duration of one DMA buffer */
    volatile uint32_t    dma_underruns;     /* interrupt so late that stale audio was played */
    volatile uint32_t    dma_late;          /* interrupt late, caught up without a gap */
    volatile uint32_t    max_isr_gap_us;    /* longest time between interrupts since last report */
    volatile uint32_t    no_desc;           /* events without descriptor info (fallback path) */

    /* test tone: `tone` is owned by the aux task; requests travel through
     * tone_next/tone_*_req under tone_mux */
    portMUX_TYPE         tone_mux;
    tone_gen_t           tone_next;
    bool                 tone_start_req;
    bool                 tone_stop_req;
    volatile bool        tone_active;       /* from tone_start() until the tone ended */
    tone_gen_t           tone;
    bool                 tone_running;      /* aux task still generating */

    portMUX_TYPE         stat_mux;          /* frames_written (producer) */
    uint64_t             frames_written;
} audio_out_t;

static audio_out_t s_ao = {
    .eng_mux = portMUX_INITIALIZER_UNLOCKED,
    .tone_mux = portMUX_INITIALIZER_UNLOCKED,
    .stat_mux = portMUX_INITIALIZER_UNLOCKED,
};

static void xsmt_set(bool unmuted)
{
    gpio_set_level(BOARD_DAC_XSMT_GPIO, unmuted ? 1 : 0);
    s_ao.muted = !unmuted;
}

static inline lldesc_t *next_desc(lldesc_t *d)
{
    return (lldesc_t *)STAILQ_NEXT(d, qe);
}

/* The driver hands us the address of the finished descriptor's `buf` field
 * (the deprecated `data` member, still filled in by ESP-IDF 5.5); from it we
 * get the descriptor and thereby the descriptor ring. Verified against
 * dma_buf; on any mismatch the caller falls back to refilling dma_buf only. */
#pragma GCC diagnostic push
#pragma GCC diagnostic ignored "-Wdeprecated-declarations"
static inline lldesc_t *desc_from_event(const i2s_event_data_t *ev)
{
    if (ev->data == NULL || ev->dma_buf == NULL) {
        return NULL;
    }
    lldesc_t *d = (lldesc_t *)((uint8_t *)ev->data - offsetof(lldesc_t, buf));
    if ((const void *)d->buf != ev->dma_buf || STAILQ_NEXT(d, qe) == NULL) {
        return NULL;
    }
    return d;
}
#pragma GCC diagnostic pop

/* I2S TX "buffer sent": refill every DMA buffer that has finished playing. */
static IRAM_ATTR bool on_sent(i2s_chan_handle_t handle, i2s_event_data_t *ev, void *user_ctx)
{
    (void)handle;
    (void)user_ctx;
    const size_t frames = ev->size / AUDIO_OUT_BYTES_PER_FRAME;
    const int64_t now = esp_timer_get_time();
    bool on_time = false;
    bool gap = false;
    if (s_ao.last_isr_us != 0) {
        uint32_t dt = (uint32_t)(now - s_ao.last_isr_us);
        if (dt > s_ao.max_isr_gap_us) {
            s_ao.max_isr_gap_us = dt;
        }
        if (dt > (I2S_DMA_DESC_NUM - 1) * s_ao.period_us) {
            s_ao.dma_underruns++;               /* a buffer was replayed before we got here */
            gap = true;
        } else if (dt > s_ao.period_us + s_ao.period_us / 2) {
            s_ao.dma_late++;                    /* caught up below, no audible effect */
        } else {
            on_time = true;
        }
    }
    s_ao.last_isr_us = now;

    lldesc_t *fin = desc_from_event(ev);

    portENTER_CRITICAL_ISR(&s_ao.eng_mux);
    if (fin == NULL) {
        s_ao.no_desc++;
        pcm_engine_fill(&s_ao.eng, (int16_t *)ev->dma_buf, frames);
    } else {
        lldesc_t *d = s_ao.next_fill ? s_ao.next_fill : fin;
        if (s_ao.rewrite_req) {
            s_ao.rewrite_req = false;
            if (on_time) {
                /* The buffer after `fin` is playing right now; everything
                 * after it is still queued and may be rewritten. Ramp down
                 * from the last frame the DAC will really play. */
                lldesc_t *playing = next_desc(fin);
                const int16_t *p = (const int16_t *)playing->buf;
                pcm_engine_ramp_from(&s_ao.eng, p[2 * (frames - 1)], p[2 * (frames - 1) + 1]);
                d = next_desc(playing);
            }
        }
        for (int i = 0; i < I2S_DMA_DESC_NUM; i++) {
            pcm_engine_fill(&s_ao.eng, (int16_t *)d->buf, frames);
            if (d == fin) {
                break;
            }
            d = next_desc(d);
        }
        s_ao.next_fill = next_desc(fin);
    }
    const uint32_t consumed = s_ao.eng.music_bytes_read;
    s_ao.eng.music_bytes_read = 0;
    const bool tone_done = s_ao.eng.tone_finished;
    portEXIT_CRITICAL_ISR(&s_ao.eng_mux);

    BaseType_t woken = pdFALSE;
    if (consumed > 0) {
        xSemaphoreGiveFromISR(s_ao.space_sem, &woken);
    }
    if ((tone_done || gap) && s_ao.aux) {
        vTaskNotifyGiveFromISR(s_ao.aux, &woken);
    }
    return woken == pdTRUE;
}

/* Zero all DMA buffers (channel disabled, interrupt excluded by the caller). */
static void clear_dma_ring_locked(void)
{
    lldesc_t *d = s_ao.next_fill;
    for (int i = 0; d != NULL && i < I2S_DMA_DESC_NUM; i++) {
        memset((void *)d->buf, 0, d->size);
        d = next_desc(d);
    }
}

/* ---- aux task: test tone + diagnostics ---------------------------------- */

static void tone_fill(void)
{
    const size_t chunk_bytes = TONE_CHUNK_FRAMES * AUDIO_OUT_BYTES_PER_FRAME;
    while (s_ao.tone_running && pcm_ring_free(&s_ao.tone_ring) >= chunk_bytes) {
        size_t n = tone_gen_fill(&s_ao.tone, s_ao.tone_scratch, TONE_CHUNK_FRAMES);
        if (n == 0) {
            s_ao.tone_running = false;
            portENTER_CRITICAL(&s_ao.eng_mux);
            s_ao.eng.tone_eof = true;
            portEXIT_CRITICAL(&s_ao.eng_mux);
            break;
        }
        pcm_ring_write(&s_ao.tone_ring, s_ao.tone_scratch, n * AUDIO_OUT_BYTES_PER_FRAME);
    }
}

static void aux_task(void *arg)
{
    (void)arg;
    uint32_t gaps_seen = 0, dry_seen = 0;
    for (;;) {
        ulTaskNotifyTake(pdTRUE, pdMS_TO_TICKS(s_ao.tone_running ? 20 : 250));

        /* the music buffer ran dry while playing (network too slow): audible */
        uint32_t dry = s_ao.eng.underruns;
        if (dry != dry_seen) {
            ESP_LOGW(TAG, "buffer ran dry (#%u): network too slow, refilling", (unsigned)dry);
            dry_seen = dry;
        }

        uint32_t gaps = s_ao.dma_underruns;
        if (gaps != gaps_seen) {
            ESP_LOGW(TAG, "DMA gap #%u: I2S interrupt up to %u ms late (late but caught up: %u)",
                     (unsigned)gaps, (unsigned)(s_ao.max_isr_gap_us / 1000), (unsigned)s_ao.dma_late);
            gaps_seen = gaps;
            s_ao.max_isr_gap_us = 0;
        }

        if (!s_ao.running) {
            s_ao.tone_running = false;
            portENTER_CRITICAL(&s_ao.tone_mux);
            s_ao.tone_start_req = false;
            s_ao.tone_stop_req = false;
            s_ao.tone_active = false;
            portEXIT_CRITICAL(&s_ao.tone_mux);
            continue;
        }

        bool start, stop;
        tone_gen_t next;
        portENTER_CRITICAL(&s_ao.tone_mux);
        start = s_ao.tone_start_req;
        stop = s_ao.tone_stop_req;
        next = s_ao.tone_next;
        s_ao.tone_start_req = false;
        s_ao.tone_stop_req = false;
        portEXIT_CRITICAL(&s_ao.tone_mux);

        if (start) {
            /* Leave tone mode while the ring is refilled: the interrupt then
             * plays music/silence for those few ms, never half a tone. */
            portENTER_CRITICAL(&s_ao.eng_mux);
            s_ao.eng.tone_mode = false;
            pcm_ring_drop(&s_ao.tone_ring);
            s_ao.eng.tone_eof = false;
            s_ao.eng.tone_finished = false;
            portEXIT_CRITICAL(&s_ao.eng_mux);
            s_ao.tone = next;
            s_ao.tone_running = true;
            tone_fill();
            portENTER_CRITICAL(&s_ao.eng_mux);
            s_ao.eng.tone_mode = true;
            portEXIT_CRITICAL(&s_ao.eng_mux);
        }
        if (stop && s_ao.tone_running) {
            tone_gen_stop(&s_ao.tone);
        }
        tone_fill();

        bool finished;
        portENTER_CRITICAL(&s_ao.eng_mux);
        finished = s_ao.eng.tone_finished;
        s_ao.eng.tone_finished = false;
        portEXIT_CRITICAL(&s_ao.eng_mux);
        if (finished) {
            portENTER_CRITICAL(&s_ao.tone_mux);
            if (!s_ao.tone_start_req) {
                s_ao.tone_active = false;
            }
            portEXIT_CRITICAL(&s_ao.tone_mux);
        }
    }
}

/* ---- API ---------------------------------------------------------------- */

esp_err_t audio_out_init(const audio_out_config_t *config)
{
    ESP_RETURN_ON_FALSE(config != NULL, ESP_ERR_INVALID_ARG, TAG, "config is NULL");
    ESP_RETURN_ON_FALSE(!s_ao.initialised, ESP_ERR_INVALID_STATE, TAG, "already initialised");
    ESP_RETURN_ON_FALSE(config->sample_rate_hz >= 8000 && config->sample_rate_hz <= 192000,
                        ESP_ERR_INVALID_ARG, TAG, "sample rate");
    ESP_RETURN_ON_FALSE(config->ring_buffer_bytes >= 64 * 1024, ESP_ERR_INVALID_ARG, TAG,
                        "ring buffer too small");

    esp_err_t ret = ESP_OK;
    s_ao.cfg = *config;
    /* pcm_ring needs a power of two */
    size_t ring = 1;
    while (ring * 2 <= s_ao.cfg.ring_buffer_bytes) {
        ring *= 2;
    }
    s_ao.cfg.ring_buffer_bytes = ring;
    if (s_ao.cfg.prebuffer_bytes > ring / 2) {
        s_ao.cfg.prebuffer_bytes = ring / 2;
    }
    s_ao.cfg.prebuffer_bytes &= ~(size_t)(AUDIO_OUT_BYTES_PER_FRAME - 1);
    s_ao.period_us = (uint32_t)((uint64_t)I2S_DMA_FRAME_NUM * 1000000u / s_ao.cfg.sample_rate_hz);

    /* XSMT low = muted, before anything else happens on the I2S pins. */
    const gpio_config_t xsmt_cfg = {
        .pin_bit_mask = 1ULL << BOARD_DAC_XSMT_GPIO,
        .mode = GPIO_MODE_OUTPUT,
        .pull_up_en = GPIO_PULLUP_DISABLE,
        .pull_down_en = GPIO_PULLDOWN_DISABLE,
        .intr_type = GPIO_INTR_DISABLE,
    };
    gpio_set_level(BOARD_DAC_XSMT_GPIO, 0);
    ESP_RETURN_ON_ERROR(gpio_config(&xsmt_cfg), TAG, "XSMT gpio");
    xsmt_set(false);

    /* Ring buffers in PSRAM (fall back to internal RAM without PSRAM). */
    const uint32_t ext = MALLOC_CAP_SPIRAM | MALLOC_CAP_8BIT;
    s_ao.ring_storage = heap_caps_malloc_prefer(ring, 2, ext, MALLOC_CAP_DEFAULT);
    s_ao.tone_storage = heap_caps_malloc_prefer(TONE_RING_BYTES, 2, ext, MALLOC_CAP_DEFAULT);
    s_ao.tone_scratch = heap_caps_malloc_prefer(TONE_CHUNK_FRAMES * AUDIO_OUT_BYTES_PER_FRAME, 2, ext,
                                                MALLOC_CAP_DEFAULT);
    s_ao.space_sem = xSemaphoreCreateBinary();
    s_ao.state_lock = xSemaphoreCreateMutex();
    s_ao.send_lock = xSemaphoreCreateMutex();
    ESP_GOTO_ON_FALSE(s_ao.ring_storage && s_ao.tone_storage && s_ao.tone_scratch && s_ao.space_sem &&
                      s_ao.state_lock && s_ao.send_lock,
                      ESP_ERR_NO_MEM, fail, TAG, "out of memory");
    pcm_ring_init(&s_ao.ring, s_ao.ring_storage, ring);
    pcm_ring_init(&s_ao.tone_ring, s_ao.tone_storage, TONE_RING_BYTES);
    pcm_engine_init(&s_ao.eng, &s_ao.ring, &s_ao.tone_ring, (uint32_t)s_ao.cfg.prebuffer_bytes,
                    (uint32_t)((uint64_t)s_ao.cfg.sample_rate_hz * PREBUFFER_MAX_WAIT_MS / 1000));

    /* I2S: master, TX only. The DMA buffers start zeroed; from then on the
     * interrupt refills every buffer right after it was sent. No auto_clear:
     * it would wipe what on_sent just wrote. */
    i2s_chan_config_t chan_cfg = I2S_CHANNEL_DEFAULT_CONFIG(I2S_NUM_0, I2S_ROLE_MASTER);
    chan_cfg.dma_desc_num = I2S_DMA_DESC_NUM;
    chan_cfg.dma_frame_num = I2S_DMA_FRAME_NUM;
    chan_cfg.auto_clear = false;
    ESP_GOTO_ON_ERROR(i2s_new_channel(&chan_cfg, &s_ao.tx, NULL), fail, TAG, "i2s_new_channel");

    i2s_std_config_t std_cfg = {
        /* No APLL on the S3: the clock comes from PLL_F160M through a fractional
         * divider. MCLK is not routed to a pin; BCK = 32 x fs for 16-bit slots,
         * which the PCM5102A PLL accepts (16/24/32-bit, 32/48/64 x fs). */
        .clk_cfg = I2S_STD_CLK_DEFAULT_CONFIG(s_ao.cfg.sample_rate_hz),
        .slot_cfg = I2S_STD_PHILIPS_SLOT_DEFAULT_CONFIG(I2S_DATA_BIT_WIDTH_16BIT, I2S_SLOT_MODE_STEREO),
        .gpio_cfg = {
            .mclk = I2S_GPIO_UNUSED,
            .bclk = BOARD_I2S_BCK_GPIO,
            .ws   = BOARD_I2S_WS_GPIO,
            .dout = BOARD_I2S_DOUT_GPIO,
            .din  = I2S_GPIO_UNUSED,
            .invert_flags = { .mclk_inv = false, .bclk_inv = false, .ws_inv = false },
        },
    };
    ESP_GOTO_ON_ERROR(i2s_channel_init_std_mode(s_ao.tx, &std_cfg), fail, TAG, "i2s std init");
    const i2s_event_callbacks_t cbs = { .on_sent = on_sent };
    ESP_GOTO_ON_ERROR(i2s_channel_register_event_callback(s_ao.tx, &cbs, NULL), fail, TAG, "i2s callbacks");

    BaseType_t ok = xTaskCreatePinnedToCore(aux_task, "audio_aux", AUX_TASK_STACK, NULL, AUX_TASK_PRIO,
                                            &s_ao.aux, tskNO_AFFINITY);
    ESP_GOTO_ON_FALSE(ok == pdPASS, ESP_ERR_NO_MEM, fail, TAG, "aux task");

    s_ao.volume = UINT16_MAX;
    s_ao.initialised = true;
    ESP_LOGI(TAG, "init: %u Hz, 16 bit stereo, ring %u bytes (%s), DMA %u x %u frames, "
             "BCK=%d WS=%d DOUT=%d XSMT=%d",
             (unsigned)s_ao.cfg.sample_rate_hz, (unsigned)ring,
             esp_ptr_external_ram(s_ao.ring_storage) ? "PSRAM" : "internal",
             (unsigned)I2S_DMA_DESC_NUM, (unsigned)I2S_DMA_FRAME_NUM,
             BOARD_I2S_BCK_GPIO, BOARD_I2S_WS_GPIO, BOARD_I2S_DOUT_GPIO, BOARD_DAC_XSMT_GPIO);
    return ESP_OK;

fail:
    if (s_ao.tx) {
        i2s_del_channel(s_ao.tx);
        s_ao.tx = NULL;
    }
    if (s_ao.space_sem) {
        vSemaphoreDelete(s_ao.space_sem);
        s_ao.space_sem = NULL;
    }
    if (s_ao.state_lock) {
        vSemaphoreDelete(s_ao.state_lock);
        s_ao.state_lock = NULL;
    }
    if (s_ao.send_lock) {
        vSemaphoreDelete(s_ao.send_lock);
        s_ao.send_lock = NULL;
    }
    heap_caps_free(s_ao.ring_storage);
    heap_caps_free(s_ao.tone_storage);
    heap_caps_free(s_ao.tone_scratch);
    s_ao.ring_storage = NULL;
    s_ao.tone_storage = NULL;
    s_ao.tone_scratch = NULL;
    return ret;
}

esp_err_t audio_out_start(void)
{
    ESP_RETURN_ON_FALSE(s_ao.initialised, ESP_ERR_INVALID_STATE, TAG, "not initialised");
    esp_err_t ret = ESP_OK;

    xSemaphoreTake(s_ao.state_lock, portMAX_DELAY);
    if (!s_ao.running) {
        portENTER_CRITICAL(&s_ao.eng_mux);
        s_ao.next_fill = NULL;          /* the DMA restarts at its first descriptor */
        s_ao.rewrite_req = false;
        s_ao.last_isr_us = 0;
        portEXIT_CRITICAL(&s_ao.eng_mux);
        ret = i2s_channel_enable(s_ao.tx);          /* clocks start, zeros are sent */
        if (ret == ESP_OK) {
            s_ao.running = true;
            vTaskDelay(pdMS_TO_TICKS(UNMUTE_DELAY_MS));   /* let the DAC PLL lock */
            xsmt_set(true);
            ESP_LOGI(TAG, "started");
        } else {
            ESP_LOGE(TAG, "i2s_channel_enable: %s", esp_err_to_name(ret));
        }
    }
    xSemaphoreGive(s_ao.state_lock);
    return ret;
}

esp_err_t audio_out_stop(void)
{
    ESP_RETURN_ON_FALSE(s_ao.initialised, ESP_ERR_INVALID_STATE, TAG, "not initialised");
    esp_err_t ret = ESP_OK;

    xSemaphoreTake(s_ao.state_lock, portMAX_DELAY);
    if (s_ao.running) {
        xsmt_set(false);
        vTaskDelay(pdMS_TO_TICKS(MUTE_RAMP_MS));     /* soft-mute ramp of the DAC */
        s_ao.running = false;
        ret = i2s_channel_disable(s_ao.tx);
        xSemaphoreTake(s_ao.send_lock, portMAX_DELAY);
        portENTER_CRITICAL(&s_ao.eng_mux);
        pcm_engine_flush(&s_ao.eng);                 /* buffered audio is discarded */
        pcm_engine_reset_output(&s_ao.eng);
        pcm_ring_drop(&s_ao.tone_ring);
        clear_dma_ring_locked();                     /* no stale audio on the next start */
        s_ao.next_fill = NULL;
        s_ao.rewrite_req = false;
        s_ao.last_isr_us = 0;
        portEXIT_CRITICAL(&s_ao.eng_mux);
        s_ao.flush_gen++;
        xSemaphoreGive(s_ao.send_lock);
        xSemaphoreGive(s_ao.space_sem);
        xTaskNotifyGive(s_ao.aux);                   /* ends a test tone */
        ESP_LOGI(TAG, "stopped");
    }
    xSemaphoreGive(s_ao.state_lock);
    return ret;
}

size_t audio_out_write(const void *pcm, size_t bytes, TickType_t timeout)
{
    if (!s_ao.initialised || pcm == NULL) {
        return 0;
    }
    bytes &= ~(size_t)(AUDIO_OUT_BYTES_PER_FRAME - 1);
    if (bytes == 0) {
        return 0;
    }

    TimeOut_t   to;
    TickType_t  remaining = timeout;
    vTaskSetTimeOutState(&to);

    const uint32_t gen = s_ao.flush_gen;
    for (;;) {
        /* A flush while we waited for space: this data belongs to before the
         * flush (seek, skip) and must not be played after it. */
        if (s_ao.flush_gen != gen) {
            return 0;
        }
        /* Single writer: the free space can only grow behind our back. */
        size_t space = pcm_ring_free(&s_ao.ring) & ~(size_t)(AUDIO_OUT_BYTES_PER_FRAME - 1);
        size_t n = bytes < space ? bytes : space;
        if (n > 0) {
            xSemaphoreTake(s_ao.send_lock, portMAX_DELAY);
            if (s_ao.flush_gen != gen) {
                xSemaphoreGive(s_ao.send_lock);
                return 0;
            }
            size_t sent = pcm_ring_write(&s_ao.ring, pcm, n);
            xSemaphoreGive(s_ao.send_lock);
            portENTER_CRITICAL(&s_ao.stat_mux);
            s_ao.frames_written += sent / AUDIO_OUT_BYTES_PER_FRAME;
            portEXIT_CRITICAL(&s_ao.stat_mux);
            return sent;
        }
        if (xTaskCheckForTimeOut(&to, &remaining) == pdTRUE) {
            return 0;
        }
        xSemaphoreTake(s_ao.space_sem, remaining);
    }
}

esp_err_t audio_out_set_mute(bool mute)
{
    ESP_RETURN_ON_FALSE(s_ao.initialised, ESP_ERR_INVALID_STATE, TAG, "not initialised");
    xSemaphoreTake(s_ao.state_lock, portMAX_DELAY);
    /* Never un-mute while the clocks are stopped: the DAC would see garbage. */
    xsmt_set(!mute && s_ao.running);
    xSemaphoreGive(s_ao.state_lock);
    return ESP_OK;
}

/* Spotify's volume (0..65535, linear slider) -> gain. A logarithmic curve
 * over 50 dB like librespot's default, so that the slider feels even; 100 %
 * is unity gain, i.e. the music passes bit-exact. */
#define VOLUME_RANGE_DB 50.0f

void audio_out_set_volume(uint16_t volume)
{
    if (!s_ao.initialised) {
        return;
    }
    uint32_t gain;
    if (volume == 0) {
        gain = 0;
    } else if (volume == UINT16_MAX) {
        gain = PCM_ENGINE_GAIN_UNITY;
    } else {
        float db = ((float)volume / 65535.0f - 1.0f) * VOLUME_RANGE_DB;
        gain = (uint32_t)(powf(10.0f, db / 20.0f) * (float)PCM_ENGINE_GAIN_UNITY + 0.5f);
    }
    portENTER_CRITICAL(&s_ao.eng_mux);
    s_ao.eng.gain_target = gain;
    portEXIT_CRITICAL(&s_ao.eng_mux);
    s_ao.volume = volume;
}

uint16_t audio_out_get_volume(void)
{
    return s_ao.initialised ? s_ao.volume : UINT16_MAX;
}

void audio_out_set_paused(bool paused)
{
    if (!s_ao.initialised) {
        return;
    }
    portENTER_CRITICAL(&s_ao.eng_mux);
    s_ao.eng.paused = paused;
    portEXIT_CRITICAL(&s_ao.eng_mux);
}

void audio_out_flush(void)
{
    if (!s_ao.initialised) {
        return;
    }
    s_ao.flush_gen++;
    /* The producer is either outside audio_out_write() or blocked waiting for
     * space; in both cases it does not hold send_lock for long. */
    xSemaphoreTake(s_ao.send_lock, portMAX_DELAY);
    portENTER_CRITICAL(&s_ao.eng_mux);
    pcm_engine_flush(&s_ao.eng);
    /* A tone keeps playing undisturbed; otherwise cut the queued DMA audio. */
    s_ao.rewrite_req = s_ao.running && !s_ao.eng.tone_mode;
    portEXIT_CRITICAL(&s_ao.eng_mux);
    xSemaphoreGive(s_ao.send_lock);
    xSemaphoreGive(s_ao.space_sem);     /* wake a waiting writer: it sees the new generation */
}

void audio_out_get_stats(audio_out_stats_t *out)
{
    if (out == NULL) {
        return;
    }
    memset(out, 0, sizeof(*out));
    if (!s_ao.initialised) {
        return;
    }
    portENTER_CRITICAL(&s_ao.stat_mux);
    out->frames_written = s_ao.frames_written;
    portEXIT_CRITICAL(&s_ao.stat_mux);
    portENTER_CRITICAL(&s_ao.eng_mux);
    out->frames_played = s_ao.eng.frames_played;
    out->frames_dropped = s_ao.eng.frames_dropped;
    out->underruns = s_ao.eng.underruns;
    out->paused = s_ao.eng.paused;
    portEXIT_CRITICAL(&s_ao.eng_mux);
    out->buffered_bytes = (uint32_t)pcm_ring_used(&s_ao.ring);
    out->running = s_ao.running;
    out->muted = s_ao.muted;
    out->dma_underruns = s_ao.dma_underruns;
    out->dma_late = s_ao.dma_late;
}

esp_err_t audio_out_tone_start(float freq_hz, float dbfs, uint32_t duration_ms)
{
    ESP_RETURN_ON_FALSE(s_ao.initialised && s_ao.running, ESP_ERR_INVALID_STATE, TAG, "not running");
    tone_gen_t t;
    if (!tone_gen_init(&t, s_ao.cfg.sample_rate_hz, freq_hz, dbfs, duration_ms)) {
        return ESP_ERR_INVALID_ARG;
    }
    portENTER_CRITICAL(&s_ao.tone_mux);
    s_ao.tone_next = t;
    s_ao.tone_start_req = true;
    s_ao.tone_stop_req = false;
    s_ao.tone_active = true;
    portEXIT_CRITICAL(&s_ao.tone_mux);
    xTaskNotifyGive(s_ao.aux);
    return ESP_OK;
}

void audio_out_tone_stop(void)
{
    if (!s_ao.initialised) {
        return;
    }
    portENTER_CRITICAL(&s_ao.tone_mux);
    if (s_ao.tone_start_req) {
        /* not picked up by the aux task yet: cancel it */
        s_ao.tone_start_req = false;
        if (!s_ao.tone_running) {
            s_ao.tone_active = false;
        }
    }
    s_ao.tone_stop_req = true;
    portEXIT_CRITICAL(&s_ao.tone_mux);
    xTaskNotifyGive(s_ao.aux);
}

bool audio_out_tone_active(void)
{
    return s_ao.tone_active;
}
