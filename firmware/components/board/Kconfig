## firmware/components/board/Kconfig
```kconfig
menu "Music Streamer board"

    choice MS_BOARD
        prompt "Target board"
        default MS_BOARD_WAVESHARE_AMOLED_164
        help
            Selects the pin map in board_pins.h. The I2S/DAC pins are the same on
            both boards; the NFC UART pins and the on-board peripherals differ.

        config MS_BOARD_WAVESHARE_AMOLED_164
            bool "Waveshare ESP32-S3-Touch-AMOLED-1.64 Rev 1.1 (final device)"

        config MS_BOARD_XIAO_ESP32S3_PLUS
            bool "Seeed Studio XIAO ESP32-S3 Plus (bench tests, no display)"
    endchoice

endmenu
```

## firmware/components/display/Kconfig
```kconfig
menu "Music Streamer display"

    choice MS_DISPLAY_ROTATION_CHOICE
        prompt "Screen rotation"
        default MS_DISPLAY_ROTATION_90
        help
            The panel is 280 x 456 (portrait). 90 and 270 give the landscape
            layout of the UI (456 x 280); pick the one that is upright for how
            the board sits in the enclosure.

        config MS_DISPLAY_ROTATION_0
            bool "0 degrees (portrait 280 x 456)"
        config MS_DISPLAY_ROTATION_90
            bool "90 degrees (landscape 456 x 280)"
        config MS_DISPLAY_ROTATION_180
            bool "180 degrees (portrait, upside down)"
        config MS_DISPLAY_ROTATION_270
            bool "270 degrees (landscape, other way round)"
    endchoice

    config MS_DISPLAY_ROTATION
        int
        default 0 if MS_DISPLAY_ROTATION_0
        default 90 if MS_DISPLAY_ROTATION_90
        default 180 if MS_DISPLAY_ROTATION_180
        default 270

    config MS_DISPLAY_QSPI_MHZ
        int "QSPI clock (MHz)"
        default 40
        range 10 80
        help
            40 MHz is what Waveshare's own example uses.

    config MS_DISPLAY_DEFAULT_BRIGHTNESS
        int "Brightness after start (%)"
        default 70
        range 5 100

    config MS_DISPLAY_BUFFER_LINES
        int "LVGL draw buffer height (lines of the native 280-pixel width)"
        default 40
        range 8 80
        help
            Two buffers of 280 x N pixels (16 bit) in internal DMA RAM, plus one
            more for software rotation. 40 lines = 22.4 kB each.

endmenu
```

## firmware/components/net/Kconfig
```kconfig
menu "Music Streamer network (net)"

    comment "Setup hotspot (WiFi portal)"

    config MS_NET_PORTAL_SSID
        string "Name of the setup hotspot"
        default "Music-Streamer"
        help
            Open WiFi network the device opens for the WiFi setup (at most 32
            bytes including the optional suffix below).

    config MS_NET_PORTAL_SSID_MAC_SUFFIX
        bool "Append -XXXX (last two bytes of the MAC address) to the name"
        default n
        help
            Useful when several devices may be in setup mode at the same time.

    config MS_NET_PORTAL_AUTO_S
        int "Start the setup hotspot after this long without WiFi (s, 0 = never)"
        default 60
        range 0 3600
        help
            The setup hotspot starts immediately when no network is stored,
            and after this many seconds without a WiFi connection (after
            boot or after losing the connection).

    config MS_NET_PORTAL_RESTART_AFTER_SETUP
        bool "Restart after a network was set up on the portal page"
        default y
        help
            The result page says "Das Gerät startet neu"; the device restarts
            8 s later and comes up cleanly in station mode. Skipped while a
            freshly installed update waits for confirmation (a restart would
            roll it back); then only the hotspot stops.

    comment "Time"

    config MS_NET_TZ
        string "Time zone (POSIX TZ string)"
        default "CET-1CEST,M3.5.0,M10.5.0/3"
        help
            Default: Europe/Berlin.

    config MS_NET_SNTP_SERVER
        string "SNTP server"
        default "pool.ntp.org"

    comment "Firmware updates (OTA)"

    config MS_OTA_MANIFEST_URL
        string "OTA manifest URL"
        default ""
        help
            HTTPS URL of manifest.json (see docs/NET.md), e.g.
            https://<user>.github.io/<repo>/ms-waveshare/manifest.json or
            https://github.com/<user>/<repo>/releases/latest/download/manifest.json.
            Empty: no update checks. Can be overridden at runtime with the
            console command "ota url <url>" (stored in NVS, key "ota_url").

    config MS_OTA_AUTO_INSTALL
        bool "Install updates without asking"
        default n
        help
            Off (default): the scheduled check only reports a newer version
            (net_ota status AVAILABLE + event); the application asks the user
            and calls net_ota_install(). On: download and install it as soon
            as nothing plays, then restart.

    config MS_OTA_FIRST_CHECK_S
        int "First update check after the network came up (s)"
        default 120
        range 10 86400

    config MS_OTA_CHECK_INTERVAL_H
        int "Update check interval (hours)"
        default 24
        range 1 720

    config MS_OTA_VERIFY_TIMEOUT_S
        int "Roll back an update that is not confirmed within (s)"
        default 600
        range 60 86400
        help
            After an update the new firmware has to call net_ota_mark_valid()
            (the application does so once WiFi and Spotify work). Otherwise it
            restarts after this time and the bootloader starts the previous
            firmware again.

    config MS_OTA_TEST_CA
        bool "TEST ONLY: trust the QEMU test CA instead of the public CA bundle"
        default n
        depends on MS_NET_QEMU_OPENETH
        help
            For tools/qemu_ota_test.py, which serves a manifest and images
            over HTTPS with a certificate from components/net/test. Only
            available in the QEMU test build.

endmenu
```

## firmware/main/Kconfig.projbuild
```kconfig
menu "Music Streamer"

    comment "Development settings. Nothing here may be committed with real values."

    config MS_WIFI_SSID
        string "WiFi SSID (temporary, until the provisioning portal exists)"
        default ""
        help
            Network to join at boot. Leave empty to skip WiFi (the firmware then
            only brings up the audio output).

    config MS_WIFI_PASSWORD
        string "WiFi password"
        default ""

    config MS_DEVICE_NAME
        string "Spotify Connect device name"
        default "Music Streamer"
        help
            Name shown in the Spotify app's device list.

    config MS_SPOTIFY_CLIENT_ID
        string "Spotify client ID"
        default ""
        help
            Client ID of your own Spotify developer app
            (https://developer.spotify.com/dashboard). The cspot fork needs it to
            obtain the access token used for resolving the audio CDN URLs.
            Spotify Connect is not started while this is empty.

    config MS_SPOTIFY_CLIENT_SECRET
        string "Spotify client secret"
        default ""
        help
            Client secret belonging to the client ID. Ends up in sdkconfig and in
            the firmware image: never publish either of them. (Planned: move to
            NVS, written once at provisioning time.)

    choice MS_SPOTIFY_BITRATE
        prompt "Spotify audio quality"
        default MS_SPOTIFY_BITRATE_320

        config MS_SPOTIFY_BITRATE_96
            bool "96 kbit/s Ogg Vorbis"
        config MS_SPOTIFY_BITRATE_160
            bool "160 kbit/s Ogg Vorbis"
        config MS_SPOTIFY_BITRATE_320
            bool "320 kbit/s Ogg Vorbis (Premium)"
    endchoice

    config MS_SPOTIFY_BITRATE
        int
        default 96 if MS_SPOTIFY_BITRATE_96
        default 160 if MS_SPOTIFY_BITRATE_160
        default 320

    config MS_HEAP_LOG_PERIOD_S
        int "Heap statistics log period (seconds, 0 = off)"
        default 60
        help
            The serial console command "status" shows the same numbers on
            demand; a frequent log line interrupts typing in the console.
        range 0 3600

    config MS_NET_QEMU_OPENETH
        bool "TEST ONLY: use QEMU's emulated Ethernet instead of WiFi"
        default n
        depends on ETH_USE_OPENETH
        help
            For smoke tests in Espressif's QEMU (see sdkconfig.qemu and
            docs/BUILD.md). Must stay disabled for firmware that runs on the
            real board.

endmenu
```
